## CMakeLists.txt
```
# SPDX-License-Identifier: Apache-2.0

cmake_minimum_required(VERSION 3.20.0)

find_package(Zephyr REQUIRED HINTS $ENV{ZEPHYR_BASE})
project(cc1352_firmware)

target_include_directories(app PRIVATE src)

FILE(GLOB app_sources src/*.c)
target_sources(app PRIVATE ${app_sources})
```

## prj.conf
```kconfig
# UART
CONFIG_SERIAL=y
CONFIG_CONSOLE=y
CONFIG_UART_CONSOLE=y
CONFIG_LOG_BACKEND_UART=y

# Logging
CONFIG_LOG=y
CONFIG_LOG_OUTPUT=y
CONFIG_NET_LOG=y
CONFIG_NET_SOCKETS_LOG_LEVEL_DBG=y
CONFIG_NET_CONFIG_LOG_LEVEL_DBG=y
CONFIG_NET_L2_IEEE802154_LOG_LEVEL_INF=y
CONFIG_UART_LOG_LEVEL_DBG=y
CONFIG_NET_STATISTICS=y
# CONFIG_NET_IF_LOG_LEVEL_DBG=y

# Networking
CONFIG_NETWORKING=y
CONFIG_NET_UDP=y
# CONFIG_NET_TCP=y
# CONFIG_NET_IPV4=y
CONFIG_NET_IPV6=y

# Generic networking options
CONFIG_NET_SOCKETS=y
CONFIG_NET_SOCKETS_POLL_MAX=4
CONFIG_NET_CONNECTION_MANAGER=y

# Network Config
CONFIG_NET_CONFIG_SETTINGS=y
CONFIG_NET_CONFIG_AUTO_INIT=y
CONFIG_NET_CONFIG_NEED_IPV6=y
# CONFIG_NET_CONFIG_NEED_IPV4=y
CONFIG_NET_CONFIG_MY_IPV6_ADDR="2001:db8::2"
CONFIG_NET_CONFIG_PEER_IPV6_ADDR="2001:db8::1"
# CONFIG_NET_CONFIG_MY_IPV4_ADDR="192.0.2.2"
# CONFIG_NET_CONFIG_PEER_IPV4_ADDR="192.0.2.1"

# Config options that probably should go into Kconfig.defconf
CONFIG_NET_L2_IEEE802154=y
CONFIG_NET_CONFIG_IEEE802154_CHANNEL=1
CONFIG_IEEE802154_CC13XX_CC26XX_SUB_GHZ_NUM_RX_BUF=6
CONFIG_NET_CONFIG_IEEE802154_RADIO_TX_POWER=20
CONFIG_IEEE802154_CC13XX_CC26XX_SUB_GHZ_CS_THRESHOLD=-20
CONFIG_NET_CONFIG_IEEE802154_PAN_ID=0xabcd
CONFIG_IEEE802154_CC13XX_CC26XX=n
CONFIG_NET_DEFAULT_IF_IEEE802154=y

# Kernel options
CONFIG_ENTROPY_GENERATOR=y
CONFIG_TEST_RANDOM_GENERATOR=y
CONFIG_INIT_STACKS=y
CONFIG_SYSTEM_WORKQUEUE_STACK_SIZE=3000
CONFIG_MAIN_STACK_SIZE=2048
CONFIG_HEAP_MEM_POOL_SIZE=4096

# Network buffers
CONFIG_NET_PKT_RX_COUNT=16
CONFIG_NET_PKT_TX_COUNT=16
CONFIG_NET_BUF_RX_COUNT=64
CONFIG_NET_BUF_TX_COUNT=64
CONFIG_NET_CONTEXT_NET_PKT_POOL=y
CONFIG_NET_BUF_DATA_SIZE=256

# IP address options
CONFIG_NET_IF_UNICAST_IPV6_ADDR_COUNT=3
CONFIG_NET_IF_MCAST_IPV6_ADDR_COUNT=4
CONFIG_NET_MAX_CONTEXTS=10

# Application Config
CONFIG_NET_L2_IEEE802154_FRAGMENT_REASS_CACHE_SIZE=32

CONFIG_NET_SHELL=y
CONFIG_PICOLIBC=y
```

## src/main.c
```c
#include "mdns.h"
#include <strings.h>
#include <zephyr/drivers/uart.h>
#include <zephyr/kernel.h>
#include <zephyr/logging/log.h>
#include <zephyr/net/socket.h>
#include <zephyr/sys/cbprintf.h>

#define UART_DEVICE_NODE DT_CHOSEN(zephyr_shell_uart)

static const struct device *const uart_dev = DEVICE_DT_GET(UART_DEVICE_NODE);
LOG_MODULE_REGISTER(cc1352_greybus, 4);

void print_addr(struct in6_addr *addr) {
  LOG_DBG("%X%X:%X%X:%X%X:%X%X:%X%X:%X%X:%X%X:%X%X", addr->s6_addr[0],
          addr->s6_addr[1], addr->s6_addr[2], addr->s6_addr[3],
          addr->s6_addr[4], addr->s6_addr[5], addr->s6_addr[6],
          addr->s6_addr[7], addr->s6_addr[8], addr->s6_addr[9],
          addr->s6_addr[10], addr->s6_addr[11], addr->s6_addr[12],
          addr->s6_addr[13], addr->s6_addr[14], addr->s6_addr[15]);
}

void main(void) {
  if (!device_is_ready(uart_dev)) {
    return;
  }

  struct in6_addr nodes[5];
  char query[] = "_greybus._tcp.local\0";
  int ret;

  int sock = mdns_socket_open_ipv6(&mdns_addr, 1000);
  if (sock < 0) {
    LOG_ERR("Failed to create socket");
    return;
  }
  LOG_DBG("Socket Created");

  while (1) {
    mdns_query_send(sock, query, strlen(query));
    LOG_DBG("Sent Request");
    ret = mdns_query_recv(sock, nodes, 5, query, strlen(query));
    LOG_DBG("Got %d devices", ret);

    if (ret > 0) {
      print_addr(&nodes[0]);
    }

    k_sleep(K_MSEC(10000));
  }
}
```

## src/mdns.c
```c
#include "mdns.h"
#include <zephyr/logging/log.h>
#include <zephyr/posix/fcntl.h>

LOG_MODULE_DECLARE(cc1352_greybus, 4);

#define MDNS_PORT 5353
#define MDNS_UNICAST_RESPONSE 0x8000U
#define MDNS_MAX_SUBSTRINGS 64
#define MDNS_RESPONSE_BUFFER_SIZE 100
#define MDNS_REQUEST_BUFFER_SIZE 100
#define MDNS_PTR_NAME_SIZE 100

#define MDNS_POINTER_OFFSET(p, ofs) ((void *)((char *)(p) + (ptrdiff_t)(ofs)))
#define MDNS_POINTER_OFFSET_CONST(p, ofs)                                      \
  ((const void *)((const char *)(p) + (ptrdiff_t)(ofs)))
#define MDNS_POINTER_DIFF(a, b)                                                \
  ((size_t)((const char *)(a) - (const char *)(b)))
#define MDNS_INVALID_POS ((size_t)-1)

enum mdns_record_type {
  MDNS_RECORDTYPE_IGNORE = 0,
  // Address
  MDNS_RECORDTYPE_A = 1,
  // Domain Name pointer
  MDNS_RECORDTYPE_PTR = 12,
  // Arbitrary text string
  MDNS_RECORDTYPE_TXT = 16,
  // IP6 Address [Thomson]
  MDNS_RECORDTYPE_AAAA = 28,
  // Server Selection [RFC2782]
  MDNS_RECORDTYPE_SRV = 33,
  // Any available records
  MDNS_RECORDTYPE_ANY = 255
};

enum mdns_class { MDNS_CLASS_IN = 1, MDNS_CLASS_ANY = 255 };

enum mdns_entry_type {
  MDNS_ENTRYTYPE_QUESTION = 0,
  MDNS_ENTRYTYPE_ANSWER = 1,
  MDNS_ENTRYTYPE_AUTHORITY = 2,
  MDNS_ENTRYTYPE_ADDITIONAL = 3
};

typedef enum mdns_entry_type mdns_entry_type_t;

struct mdns_string_t {
  const char *str;
  size_t length;
};

typedef enum mdns_record_type mdns_record_type_t;

struct mdns_query_t {
  mdns_record_type_t type;
  const char *name;
  size_t length;
};

struct mdns_string_pair_t {
  size_t offset;
  size_t length;
  int ref;
};

struct mdns_header_t {
  uint16_t query_id;
  uint16_t flags;
  uint16_t questions;
  uint16_t answer_rrs;
  uint16_t authority_rrs;
  uint16_t additional_rrs;
};

struct mdns_string_table_t {
  size_t offset[16];
  size_t count;
  size_t next;
};

static void mdns_socket_close(int sock) { zsock_close(sock); }

static bool join_multicast_group(const struct in6_addr *mcast_addr) {
  struct net_if_mcast_addr *mcast;
  struct net_if *iface;

  iface = net_if_get_default();
  if (!iface) {
    LOG_ERR("Could not get the default interface\n");
    return false;
  }

  mcast = net_if_ipv6_maddr_add(iface, mcast_addr);
  if (!mcast) {
    LOG_ERR("Could not add multicast address to interface");
    return false;
  }

  net_if_ipv6_maddr_join(iface, mcast);
  return true;
}

static uint16_t mdns_ntohs(const void *data) {
  uint16_t aligned;

  memcpy(&aligned, data, sizeof(uint16_t));
  return ntohs(aligned);
}

static void *mdns_htons(void *data, uint16_t val) {
  val = htons(val);
  memcpy(data, &val, sizeof(uint16_t));
  return MDNS_POINTER_OFFSET(data, sizeof(uint16_t));
}

static int mdns_is_string_ref(uint8_t val) { return (0xC0 == (val & 0xC0)); }

static struct mdns_string_pair_t
mdns_get_next_substring(const void *rawdata, size_t size, size_t offset) {
  int recursion;
  size_t length;
  const uint8_t *buffer = (const uint8_t *)rawdata;
  struct mdns_string_pair_t pair = {MDNS_INVALID_POS, 0, 0};

  if (offset >= size)
    return pair;
  if (!buffer[offset]) {
    pair.offset = offset;
    return pair;
  }
  recursion = 0;
  while (mdns_is_string_ref(buffer[offset])) {
    if (size < offset + 2)
      return pair;

    offset = mdns_ntohs(MDNS_POINTER_OFFSET(buffer, offset)) & 0x3fff;
    if (offset >= size)
      return pair;

    pair.ref = 1;
    if (++recursion > 16)
      return pair;
  }

  length = (size_t)buffer[offset++];
  if (size < offset + length)
    return pair;

  pair.offset = offset;
  pair.length = length;

  return pair;
}

static int mdns_socket_setup_ipv6(int sock, const struct in6_addr *jaddr,
                                  int timeout_msec) {
  unsigned int reuseaddr = 1;
  struct timeval tv;

  tv.tv_usec = timeout_msec * 1000;

  if (!join_multicast_group(jaddr)) {
    LOG_ERR("Failed to join multicast group");
    return -1;
  }

  zsock_setsockopt(sock, SOL_SOCKET, SO_REUSEADDR, (const char *)&reuseaddr,
                   sizeof(reuseaddr));
  zsock_setsockopt(sock, SOL_SOCKET, SO_REUSEPORT, (const char *)&reuseaddr,
                   sizeof(reuseaddr));
  zsock_setsockopt(sock, SOL_SOCKET, SO_RCVTIMEO, &tv, sizeof(tv));

  struct sockaddr_in6 sock_addr;
  memset(&sock_addr, 0, sizeof(struct sockaddr_in6));
  sock_addr.sin6_family = AF_INET6;
  sock_addr.sin6_addr = in6addr_any;
  sock_addr.sin6_port = htons(MDNS_PORT);

  if (zsock_bind(sock, (struct sockaddr *)&sock_addr,
                 sizeof(struct sockaddr_in6)))
    return -1;

  const int flags = zsock_fcntl(sock, F_GETFL, 0);
  zsock_fcntl(sock, F_SETFL, flags | O_NONBLOCK);

  return 0;
}

static size_t mdns_string_find(const char *str, size_t length, char c,
                               size_t offset) {
  const void *found;

  if (offset >= length)
    return MDNS_INVALID_POS;
  found = memchr(str + offset, c, length - offset);
  if (found)
    return (size_t)MDNS_POINTER_DIFF(found, str);
  return MDNS_INVALID_POS;
}

static size_t mdns_string_table_find(struct mdns_string_table_t *string_table,
                                     const void *buffer, size_t capacity,
                                     const char *str, size_t first_length,
                                     size_t total_length) {
  size_t istr, offset, dot_pos, current_length;

  if (!string_table)
    return MDNS_INVALID_POS;

  for (istr = 0; istr < string_table->count; ++istr) {
    if (string_table->offset[istr] >= capacity)
      continue;
    offset = 0;
    struct mdns_string_pair_t sub_string =
        mdns_get_next_substring(buffer, capacity, string_table->offset[istr]);
    if (!sub_string.length || (sub_string.length != first_length))
      continue;
    if (memcmp(str, MDNS_POINTER_OFFSET(buffer, sub_string.offset),
               sub_string.length))
      continue;

    // Initial substring matches, now match all remaining substrings
    offset += first_length + 1;
    while (offset < total_length) {
      dot_pos = mdns_string_find(str, total_length, '.', offset);
      if (dot_pos == MDNS_INVALID_POS)
        dot_pos = total_length;
      current_length = dot_pos - offset;

      sub_string = mdns_get_next_substring(
          buffer, capacity, sub_string.offset + sub_string.length);
      if (!sub_string.length || (sub_string.length != current_length))
        break;
      if (memcmp(str + offset, MDNS_POINTER_OFFSET(buffer, sub_string.offset),
                 sub_string.length))
        break;

      offset = dot_pos + 1;
    }

    // Return reference offset if entire string matches
    if (offset >= total_length)
      return string_table->offset[istr];
  }

  return MDNS_INVALID_POS;
}

static void *mdns_string_make_ref(void *data, size_t capacity,
                                  size_t ref_offset) {
  if (capacity < 2)
    return 0;
  return mdns_htons(data, 0xC000 | (uint16_t)ref_offset);
}

static void mdns_string_table_add(struct mdns_string_table_t *string_table,
                                  size_t offset) {
  size_t table_capacity;

  if (!string_table)
    return;

  string_table->offset[string_table->next] = offset;

  table_capacity =
      sizeof(string_table->offset) / sizeof(string_table->offset[0]);
  if (++string_table->count > table_capacity)
    string_table->count = table_capacity;
  if (++string_table->next >= table_capacity)
    string_table->next = 0;
}

static void *mdns_string_make(void *buffer, size_t capacity, void *data,
                              const char *name, size_t length,
                              struct mdns_string_table_t *string_table) {
  size_t last_pos = 0;
  size_t remain = capacity - MDNS_POINTER_DIFF(data, buffer);
  size_t pos, sub_length, total_length, ref_offset;

  if (name[length - 1] == '.')
    --length;
  while (last_pos < length) {
    pos = mdns_string_find(name, length, '.', last_pos);
    sub_length = ((pos != MDNS_INVALID_POS) ? pos : length) - last_pos;
    total_length = length - last_pos;

    ref_offset = mdns_string_table_find(
        string_table, buffer, capacity,
        (char *)MDNS_POINTER_OFFSET(name, last_pos), sub_length, total_length);
    if (ref_offset != MDNS_INVALID_POS)
      return mdns_string_make_ref(data, remain, ref_offset);

    if (remain <= (sub_length + 1))
      return 0;

    *(unsigned char *)data = (unsigned char)sub_length;
    memcpy(MDNS_POINTER_OFFSET(data, 1), name + last_pos, sub_length);
    mdns_string_table_add(string_table, MDNS_POINTER_DIFF(data, buffer));

    data = MDNS_POINTER_OFFSET(data, sub_length + 1);
    last_pos = ((pos != MDNS_INVALID_POS) ? pos + 1 : length);
    remain = capacity - MDNS_POINTER_DIFF(data, buffer);
  }

  if (!remain)
    return 0;

  *(unsigned char *)data = 0;
  return MDNS_POINTER_OFFSET(data, 1);
}

static int mdns_multicast_send(int sock, const void *buffer, size_t size) {
  struct sockaddr_storage addr_storage;
  struct sockaddr_in addr;
  struct sockaddr_in6 addr6;
  struct sockaddr *saddr = (struct sockaddr *)&addr_storage;
  socklen_t saddrlen = sizeof(struct sockaddr_storage);

  if (zsock_getsockname(sock, saddr, &saddrlen))
    return -1;
  if (saddr->sa_family == AF_INET6) {
    memset(&addr6, 0, sizeof(addr6));
    addr6.sin6_family = AF_INET6;
    addr6.sin6_addr.s6_addr[0] = 0xFF;
    addr6.sin6_addr.s6_addr[1] = 0x02;
    addr6.sin6_addr.s6_addr[15] = 0xFB;
    addr6.sin6_port = htons((unsigned short)MDNS_PORT);
    saddr = (struct sockaddr *)&addr6;
    saddrlen = sizeof(addr6);
  } else {
    memset(&addr, 0, sizeof(addr));
    addr.sin_family = AF_INET;
    addr.sin_addr.s_addr = htonl((((uint32_t)224U) << 24U) | ((uint32_t)251U));
    addr.sin_port = htons((unsigned short)MDNS_PORT);
    saddr = (struct sockaddr *)&addr;
    saddrlen = sizeof(addr);
  }

  if (zsock_sendto(sock, (const char *)buffer, size, 0, saddr, saddrlen) < 0)
    return -1;
  return 0;
}

static int mdns_multiquery_send(int sock, const struct mdns_query_t *query,
                                size_t count, void *buffer, size_t capacity,
                                uint16_t query_id) {
  socklen_t saddrlen;
  size_t iq, tosend;
  struct sockaddr_storage addr_storage;
  struct sockaddr *saddr;
  struct mdns_header_t *header;
  uint16_t rclass = MDNS_CLASS_IN;
  void *data;

  if (!count || (capacity < (sizeof(struct mdns_header_t) + (6 * count))))
    return -1;

  saddr = (struct sockaddr *)&addr_storage;
  saddrlen = sizeof(addr_storage);
  if (zsock_getsockname(sock, saddr, &saddrlen) == 0) {
    if ((saddr->sa_family == AF_INET) &&
        (ntohs(((struct sockaddr_in *)saddr)->sin_port) == MDNS_PORT))
      rclass &= ~MDNS_UNICAST_RESPONSE;
    else if ((saddr->sa_family == AF_INET6) &&
             (ntohs(((struct sockaddr_in6 *)saddr)->sin6_port) == MDNS_PORT))
      rclass &= ~MDNS_UNICAST_RESPONSE;
  }

  header = (struct mdns_header_t *)buffer;
  // Query ID
  header->query_id = htons((unsigned short)query_id);
  // Flags
  header->flags = 0;
  // Questions
  header->questions = htons((unsigned short)count);
  // No answer, authority or additional RRs
  header->answer_rrs = 0;
  header->authority_rrs = 0;
  header->additional_rrs = 0;
  // Fill in questions
  data = MDNS_POINTER_OFFSET(buffer, sizeof(struct mdns_header_t));
  for (iq = 0; iq < count; ++iq) {
    // Name string
    data = mdns_string_make(buffer, capacity, data, query[iq].name,
                            query[iq].length, 0);
    if (!data)
      return -1;
    // Record type
    data = mdns_htons(data, query[iq].type);
    //! Optional unicast response based on local port, class IN
    data = mdns_htons(data, rclass);
  }

  tosend = MDNS_POINTER_DIFF(data, buffer);
  if (mdns_multicast_send(sock, buffer, (size_t)tosend))
    return -1;
  return query_id;
}

static int mdns_string_skip(const void *buffer, size_t size, size_t *offset) {
  size_t cur = *offset;
  struct mdns_string_pair_t substr;
  unsigned int counter = 0;

  do {
    substr = mdns_get_next_substring(buffer, size, cur);
    if ((substr.offset == MDNS_INVALID_POS) ||
        (counter++ > MDNS_MAX_SUBSTRINGS))
      return 0;
    if (substr.ref) {
      *offset = cur + 2;
      return 1;
    }
    cur = substr.offset + substr.length;
  } while (substr.length);

  *offset = cur + 1;
  return 1;
}

static struct mdns_string_t mdns_string_extract(const void *buffer, size_t size,
                                                size_t *offset, char *str,
                                                size_t capacity) {
  size_t to_copy;
  size_t cur = *offset;
  size_t end = MDNS_INVALID_POS;
  struct mdns_string_pair_t substr;
  struct mdns_string_t result;
  char *dst = str;
  unsigned int counter = 0;
  size_t remain = capacity;

  result.str = str;
  result.length = 0;

  do {
    substr = mdns_get_next_substring(buffer, size, cur);
    if ((substr.offset == MDNS_INVALID_POS) ||
        (counter++ > MDNS_MAX_SUBSTRINGS))
      return result;
    if (substr.ref && (end == MDNS_INVALID_POS))
      end = cur + 2;
    if (substr.length) {
      to_copy = (substr.length < remain) ? substr.length : remain;
      memcpy(dst, (const char *)buffer + substr.offset, to_copy);
      dst += to_copy;
      remain -= to_copy;
      if (remain) {
        *dst++ = '.';
        --remain;
      }
    }
    cur = substr.offset + substr.length;
  } while (substr.length);

  if (end == MDNS_INVALID_POS)
    end = cur + 1;
  *offset = end;

  result.length = capacity - remain;
  return result;
}

static struct mdns_string_t
mdns_record_parse_ptr(const void *buffer, size_t size, size_t offset,
                      size_t length, char *strbuffer, size_t capacity) {
  struct mdns_string_t empty = {0, 0};
  // PTR record is just a string
  if ((size >= offset + length) && (length >= 2))
    return mdns_string_extract(buffer, size, &offset, strbuffer, capacity);
  return empty;
}

static bool mdns_answer_check(const void *buffer, size_t size, size_t *offset,
                              size_t records, const char *query,
                              size_t query_len) {
  struct mdns_string_t namestr;
  size_t parsed = 0, i, record_length, record_offset;
  uint16_t length;
  char namebuffer[MDNS_PTR_NAME_SIZE];
  // char expected[] = "zephyr._greybus._tcp.local\0";
  char expected[] = "zephyr.\0";

  for (i = 0; i < records; ++i) {
    mdns_string_skip(buffer, size, offset);
    if (((*offset) + 10) > size)
      return false;
    const uint16_t *data =
        (const uint16_t *)MDNS_POINTER_OFFSET(buffer, *offset);

    // uint16_t rtype = mdns_ntohs(data++);
    // uint16_t rclass = mdns_ntohs(data++);
    // uint32_t ttl = mdns_ntohl(data);
    data += 4;
    length = mdns_ntohs(data++);

    *offset += 10;

    if (length <= (size - (*offset))) {
      record_length = length;
      record_offset = *offset;
      namestr =
          mdns_record_parse_ptr(buffer, size, record_offset, record_length,
                                namebuffer, sizeof(namebuffer));

      if ((memcmp(expected, namestr.str, strlen(expected)) == 0) &&
          (memcmp(query, namestr.str + strlen(expected), query_len) == 0)) {
        return true;
      }
      ++parsed;
    }

    *offset += length;
  }
  return false;
}

static size_t mdns_query_recv_internal(int sock, struct in6_addr *addrptr,
                                       const char *query, size_t query_len) {
  int ret;
  size_t data_size, offset;
  uint16_t flags, questions, answer_rrs;
  struct sockaddr_in6 addr;
  char buffer[MDNS_RESPONSE_BUFFER_SIZE];
  struct sockaddr *saddr = (struct sockaddr *)&addr;
  socklen_t addrlen = sizeof(addr);
  const uint16_t *data = (const uint16_t *)buffer;

  memset(&addr, 0, sizeof(addr));

  ret = zsock_recvfrom(sock, buffer, sizeof(buffer), 0, saddr, &addrlen);
  if (ret <= 0) {
    goto early_exit;
  }

  data_size = (size_t)ret;

  // uint16_t query_id = mdns_ntohs(data++);
  data++;
  flags = mdns_ntohs(data++);
  questions = mdns_ntohs(data++);
  answer_rrs = mdns_ntohs(data++);
  // uint16_t authority_rrs = mdns_ntohs(data++);
  // uint16_t additional_rrs = mdns_ntohs(data++);
  data += 2;
  (void)sizeof(flags);

  // Skip questions part
  for (int i = 0; i < questions; ++i) {
    offset = MDNS_POINTER_DIFF(data, buffer);
    if (!mdns_string_skip(buffer, data_size, &offset)) {
      goto early_exit;
    }
    data = (const uint16_t *)MDNS_POINTER_OFFSET_CONST(buffer, offset);
    // Record type and class not used, skip
    // uint16_t rtype = mdns_ntohs(data++);
    // uint16_t rclass = mdns_ntohs(data++);
    data += 2;
  }

  offset = MDNS_POINTER_DIFF(data, buffer);
  if (mdns_answer_check(buffer, data_size, &offset, answer_rrs, query,
                        query_len)) {
    net_ipaddr_copy(addrptr, &addr.sin6_addr);
    return 1;
  }

early_exit:
  return 0;
}

size_t mdns_query_recv(int sock, struct in6_addr *addr_list,
                       size_t addr_list_len, const char *query,
                       size_t query_len) {
  size_t ret, total = 0;

  do {
    ret = mdns_query_recv_internal(sock, &addr_list[total], query, query_len);
    total += ret;
  } while (ret && total < addr_list_len);

  return total;
}

int mdns_socket_open_ipv6(const struct in6_addr *jaddr, int timeout_msec) {
  int sock = (int)zsock_socket(AF_INET6, SOCK_DGRAM, IPPROTO_UDP);
  if (sock < 0)
    return -1;
  if (mdns_socket_setup_ipv6(sock, jaddr, timeout_msec)) {
    mdns_socket_close(sock);
    return -1;
  }
  return sock;
}

int mdns_query_send(int sock, const char *name, size_t length) {
  struct mdns_query_t query;
  char buffer[MDNS_REQUEST_BUFFER_SIZE];

  query.type = MDNS_RECORDTYPE_PTR;
  query.name = name;
  query.length = length;
  return mdns_multiquery_send(sock, &query, 1, buffer, sizeof(buffer), 0);
}
```

## src/mdns.h
```c
#ifndef _MDNS_H
#define _MDNS_H

#include <zephyr/net/socket.h>

static const struct in6_addr mdns_addr = {
    {{0xFF, 0x02, 0, 0, 0, 0, 0, 0, 0, 0, 0, 0, 0, 0, 0, 0xFB}}};

int mdns_socket_open_ipv6(const struct in6_addr *saddr, int timeout_msec);

int mdns_query_send(int sock, const char *name, size_t length);

size_t mdns_query_recv(int sock, struct in6_addr *addr_list,
                       size_t addr_list_len, const char *query,
                       size_t query_len);

#endif
```
